## prj.conf
```kconfig
#
# Copyright (c) 2022 Nordic Semiconductor ASA
#
# SPDX-License-Identifier: LicenseRef-Nordic-5-Clause
#

# Wi-Fi
# STEP 1.1 - Enable the Wi-Fi relevant configurations
CONFIG_WIFI=y
CONFIG_WIFI_NRF700X=y
CONFIG_WPA_SUPP=y

# STEP 2 - Configure the Wi-Fi credentials
CONFIG_WIFI_CREDENTIALS=y
# STEP 12.1 - Disable static Wi-Fi network configuration
CONFIG_WIFI_CREDENTIALS_STATIC=n
# CONFIG_WIFI_CREDENTIALS_STATIC_SSID="Frog"
# CONFIG_WIFI_CREDENTIALS_STATIC_PASSWORD="gucVAP20"

# Networking Management API
# STEP 1.2 Enable the Network Management relevant configurations
CONFIG_NET_MGMT=y
CONFIG_NET_MGMT_EVENT=y
CONFIG_NET_MGMT_EVENT_INFO=y
CONFIG_NET_MGMT_EVENT_STACK_SIZE=4096
CONFIG_NET_CONNECTION_MANAGER=y
CONFIG_WIFI_MGMT_EXT=y

# STEP 12.3 Enable support for shell commands
CONFIG_SHELL=y                      # Enable shell commands
CONFIG_WIFI_CREDENTIALS_SHELL=y     # ...and include the shell commands to manage Wi-Fi credentials
CONFIG_SHELL_STACK_SIZE=4400

# Logging
CONFIG_LOG=y

# DK library
CONFIG_DK_LIBRARY=y

# System settings
CONFIG_NEWLIB_LIBC=y
CONFIG_NEWLIB_LIBC_NANO=n

# Networking
CONFIG_NETWORKING=y
CONFIG_NET_NATIVE=y
CONFIG_NET_SOCKETS=y
CONFIG_NET_L2_ETHERNET=y
CONFIG_NET_IPV6=n
CONFIG_NET_IPV4=y
CONFIG_NET_DHCPV4=y
# CONFIG_NET_LOG=y

# Added by Glen for further debugging
# CONFIG_WIFI_LOG_LEVEL_DBG=y
# CONFIG_NET_CONNECTION_MANAGER_LOG_LEVEL_DBG=y
# CONFIG_NET_CONN_LOG_LEVEL_DBG=y
# CONFIG_NET_L2_WIFI_MGMT_LOG_LEVEL_DBG=y
# CONFIG_WPA_SUPP_LOG_LEVEL_DBG=y     # This gives a ton of info on the scans and connection attempt process

# Memory
CONFIG_SYSTEM_WORKQUEUE_STACK_SIZE=4096
CONFIG_MAIN_STACK_SIZE=4096
CONFIG_HEAP_MEM_POOL_SIZE=153600
```

## boards/nrf7002dk_nrf5340_cpuapp.conf
```kconfig
# When building without TF-M we use the Zephyr settings system rather than the PSA (Protected Storage) which requires TF-M
CONFIG_WIFI_CREDENTIALS_BACKEND_SETTINGS=y      # Zephyr settings (like Flash Data System)
CONFIG_FLASH=y                                  # enable flash drivers
CONFIG_FLASH_PAGE_LAYOUT=y                      # API for retrieving layout of pages
CONFIG_FLASH_MAP=y                              # enable the flash map abstraction module
CONFIG_NVS=y                                    # enable non-volatile storage support
CONFIG_SETTINGS=y                               # enable settings subsystem
CONFIG_SETTINGS_NVS=y                           # enable NVS storage of settings
```

## boards/nrf7002dk_nrf5340_cpuapp_ns.conf
```kconfig
# Use PSA (Protected Storage) is a part of TF-M, so use it instead of Zephyr's settings system when building with TF-M
CONFIG_WIFI_CREDENTIALS_BACKEND_PSA=y
CONFIG_TFM_PROFILE_TYPE_MEDIUM=y
CONFIG_PM_PARTITION_SIZE_TFM_SRAM=0x18000
CONFIG_MBEDTLS_HEAP_SIZE=16384
```

## src/main.c
```c
/*
 * Copyright (c) 2023 Nordic Semiconductor ASA
 *
 * SPDX-License-Identifier: LicenseRef-Nordic-5-Clause
 */

#include <errno.h>
#include <stddef.h>
#include <string.h>
#include <stdio.h>
#include <zephyr/kernel.h>
#include <zephyr/types.h>
#include <zephyr/logging/log.h>

#include <dk_buttons_and_leds.h>

/* STEP 3 - Include the necessary header files */
#include <zephyr/net/wifi.h>
#include <zephyr/net/wifi_mgmt.h>
#include <zephyr/net/net_mgmt.h>
#include <net/wifi_mgmt_ext.h>

/* STEP 12.4 - Include the header file for the Wi-FI credentials library */
#include <net/wifi_credentials.h>

LOG_MODULE_REGISTER(Lesson2_Exercise2, LOG_LEVEL_INF);

/* STEP 4 - Define a macro for the relevant network events */
#define EVENT_MASK (NET_EVENT_L4_CONNECTED | NET_EVENT_L4_DISCONNECTED)

/* STEP 5 - Declare the callback structure for Wi-Fi events */
static struct net_mgmt_event_callback mgmt_cb;

/* STEP 6.1 - Define the boolean connected and the semaphore run_app */
static bool connected;
static K_SEM_DEFINE(run_app, 0, 1);

/* STEP 6.2 - Define the callback function for network events */
static void net_mgmt_event_handler(struct net_mgmt_event_callback *cb,
			uint32_t mgmt_event, struct net_if *iface)
{
	if ((mgmt_event & EVENT_MASK) != mgmt_event) {
		LOG_ERR("Got mgmt_event %d", mgmt_event);
		return;
	}
	if (mgmt_event == NET_EVENT_L4_CONNECTED) {
		LOG_INF("Network connected");
		connected = true;
		dk_set_led_on(DK_LED1);
		k_sem_give(&run_app);
		return;
	}
	if (mgmt_event == NET_EVENT_L4_DISCONNECTED) {
		if (connected == false) {
			LOG_INF("Waiting for network to be connected");
		} else {
			dk_set_led_off(DK_LED1);
			LOG_INF("Network disconnected");
			connected = false;
		}
		k_sem_reset(&run_app);
		return;
	}
}


// static int wifi_args_to_params(struct wifi_connect_req_params *params)
// {
// 	/* STEP 7.1 - Populate the SSID and password */
// 	params->ssid = CONFIG_WIFI_CREDENTIALS_STATIC_SSID;
// 	params->ssid_length = strlen(params->ssid);
// 	params->psk = CONFIG_WIFI_CREDENTIALS_STATIC_PASSWORD;
// 	params->psk_length = strlen(params->psk);
// 	// params->sae_password = NULL;
// 	// params->sae_password_length = 0;

// 	/* STEP 7.2 - Populate the rest of the relevant members */
// 	params->channel = WIFI_CHANNEL_ANY;
// 	params->security = WIFI_SECURITY_TYPE_PSK;
// 	params->mfp = WIFI_MFP_OPTIONAL;
// 	params->timeout = SYS_FOREVER_MS;
// 	params->band = WIFI_FREQ_BAND_UNKNOWN;
// 	// This is required.  If a random non-zero bssid is set, then it will think we require an AP with that MAC/BSSID
// 	memset(params->bssid, 0, sizeof(params->bssid));

// 	return 0;
// }


int main(void)
{
	// /* STEP 8.1 - Declare the variable for the network configuration parameters */
	// struct wifi_connect_req_params cnx_params;

	// /* STEP 8.2 - Get the network interface */
	// struct net_if *iface = net_if_get_first_wifi();
	// if (iface == NULL) {
	// 	LOG_ERR("Returned network interface is NULL");
	// 	return -1;
	// }

	if (dk_leds_init() != 0) {
		LOG_ERR("Failed to initialize the LED library");
	}

	/* Sleep to allow initialization of Wi-Fi driver */
	k_sleep(K_SECONDS(1));

	/* STEP 9 - Initialize and add the callback function for network events */
	net_mgmt_init_event_callback(&mgmt_cb, net_mgmt_event_handler, EVENT_MASK);
	net_mgmt_add_event_callback(&mgmt_cb);

	// /* STEP 10 - Populate cnx_params with the network configuration */
	// wifi_args_to_params(&cnx_params);

	// /* STEP 11 - Call net_mgmt() to request the Wi-Fi connection */
	// LOG_INF("Connecting to Wi-Fi");
	// int err = net_mgmt(NET_REQUEST_WIFI_CONNECT, iface, &cnx_params, sizeof(struct wifi_connect_req_params));
	// if (err) {
	// 	LOG_ERR("Connecting to Wi-Fi failed, err: %d", err);
	// 	return ENOEXEC;
	// }

	// This will wait forever until a connection is made
	k_sem_take(&run_app, K_FOREVER);

	return 0;
}
```
